AUTOSAR XML
3 x :
  Container1
    element Element1
  Container2
    element Element2
  Container3
    element Element3
